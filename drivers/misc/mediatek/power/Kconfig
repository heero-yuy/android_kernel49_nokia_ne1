## drivers/misc/mediatek/power/Kconfig
```kconfig
# Power Related
config MTK_PMIC
	bool "MediaTek PMIC driver"
	default y
	---help---
	  MediaTek PMIC driver

config MTK_CHARGER_INTERFACE
	bool "Mediatek Charger Interface"
	default n
	---help---
	  Mediatek Charger Interface.
	  Say y to support this module.
	  Say n and choose other chargers and interface.
	  Do not select this module if you've ported your own interface.

#
config CHARGER_RT9458
	bool "RT9458_SUPPORT"
	select MTK_SWITCH_INPUT_OUTPUT_CURRENT_SUPPORT
	select MTK_CHARGER_INTERFACE
	default n
	---help---
	  Richtek RT9458 driver.
	  Say y to support this driver.
	  Say n and choose other chargers.
	  This driver uses I2C bus.

# add
config MTK_BQ24157_SUPPORT
	bool "MTK_BQ24157_SUPPORT"
	default n
	---help---
	Mediatek TI BQ24157 driver.
	Set y to support this driver.
	Set n and choose other chargers.
	This driver uses I2c bus.
```
